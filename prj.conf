## CMakeLists.txt
```
cmake_minimum_required(VERSION 3.20.0)

find_package(Zephyr)
project(uwb_swarm_ranging)

target_sources(app PRIVATE src/main.c src/testbed.c src/nodes.c src/measurements.c src/estimation.c src/log.c src/history.c)
```

## prj.conf
```kconfig
CONFIG_LOG=y
CONFIG_LOG_DEFAULT_LEVEL=4
CONFIG_LOG_MODE_IMMEDIATE=y
CONFIG_LOG_PRINTK=y

CONFIG_SCHED_SCALABLE=y

#CONFIG_NET_TC_THREAD_COOPERATIVE=y
CONFIG_NETWORKING=y
CONFIG_IEEE802154=y
CONFIG_IEEE802154_DW1000=y
CONFIG_NET_PKT_TIMESTAMP=y
CONFIG_IEEE802154_RAW_MODE=y

CONFIG_NEWLIB_LIBC=y
CONFIG_NEWLIB_LIBC_NANO=n

#CONFIG_CBPRINTF_FP_SUPPORT=y
#CONFIG_NEWLIB_LIBC_FLOAT_PRINTF=y

CONFIG_SERIAL=y
#CONFIG_NET_L2_IEEE802154=n

#CONFIG_NO_OPTIMIZATIONS=n


CONFIG_CMSIS_DSP=y
CONFIG_CMSIS_DSP_MATRIX=y
CONFIG_CMSIS_DSP_MATRIXCHECK=y

CONFIG_HWINFO=y
CONFIG_PM_DEVICE=n
CONFIG_PM_DEVICE_RUNTIME=n
#CONFIG_CLOCK_CONTROL_NRF_K32SRC_RC=n # TODO check if this changes anything!
```

## src/estimation.c
```c
#include <zephyr.h>
#include <stdlib.h>
#include <arm_math_f16.h>
#include <logging/log.h>
#include <stdio.h>

#include "estimation.h"
#include "nodes.h"
#include "log.h"
#include "measurements.h"

LOG_MODULE_REGISTER(estimation);

#if 1
    typedef float16_t matrix_entry_t;
    #define MATRIX arm_matrix_instance_f16
    #define OP_MULT arm_mat_mult_f16
    #define OP_INV arm_mat_inverse_f16
    #define OP_TRANS arm_mat_trans_f16
    #define OP_MEAN arm_mean_f16
#else
    typedef float32_t matrix_entry_t;
    #define MATRIX arm_matrix_instance_f32
    #define OP_MULT arm_mat_mult_f32
    #define OP_INV arm_mat_inverse_f32
    #define OP_TRANS arm_mat_trans_f32
    #define OP_MEAN arm_mean_f32
#endif



#define MAX_SD_IN_M (0.1)
#define MAX_SD_IN_UWB_TS (MAX_SD_IN_M/SPEED_OF_LIGHT_M_PER_UWB_TU)


#define MAX_VAR_IN_M (MAX_SD_IN_UWB_TS*MAX_SD_IN_UWB_TS)




// the maximum of supported nodes for estimation (limited by memory sadly)
// TODO: They use up a LOT of memory! We could later allocate them dynamically (if we would need that extra space!)

void print_matrix(MATRIX *m) {
return;
    char buf[32];
    for (int r = 0; r < m->numRows; r++) {
         for (int c = 0; c < m->numCols; c++) {
            int32_t val = m->pData[r*m->numCols + c];
            snprintf(buf, sizeof(buf), "%d ", val);
            uart_out(buf);
        }
        uart_out("\n");
    }
}


static matrix_entry_t matrix_data_a[EST_MAX_INPUTS * EST_MAX_INPUTS];
static matrix_entry_t matrix_data_b[EST_MAX_PARAMS * EST_MAX_INPUTS];
static matrix_entry_t matrix_data_c[EST_MAX_INPUTS * EST_MAX_INPUTS];

static void estimate(
    uint8_t num_nodes,
    float32_t delays_out[EST_MAX_NODES],
    float32_t tofs_out[EST_MAX_PAIRS],
    float32_t mean_measurements[EST_MAX_PAIRS],
    float32_t var_measurements[EST_MAX_PAIRS],
    bool delay_known[EST_MAX_NODES],
    float32_t known_delays[EST_MAX_NODES],
    bool tof_known[EST_MAX_PAIRS],
    float32_t known_tofs[EST_MAX_PAIRS],
    float32_t max_pair_variance
) {

    if (num_nodes > EST_MAX_NODES) {
        LOG_ERR("Num Nodes too high!");
        return;
    }

    int ret = 0;

    uint32_t num_pairs = PAIRS(num_nodes); // we use the actual number of input pairs
    uint32_t num_input_rows = PAIRS(num_nodes); // we use the actual number of input pairs
    uint32_t num_input_cols = 0;

    // we add all unknown delays and distances as columns
    for(int i = 0; i < num_nodes; i++) {
        if (!delay_known[i]) {
            num_input_cols++;
        }
    }

    if (num_input_cols > EST_MAX_NODES) {
        LOG_ERR("Inference of TOFs currently not supported! Only antenna delays as of now");
        return;
    }


    for(int i = 0; i < num_pairs; i++) {
        if (!tof_known[i]) {
            num_input_cols++;
        }
        // TDDO: We could also filter by variance here
    }

    // make sure that matrices are empty! we only need to reset matrix A since the others are overriden anyway
    // this zero matrix a
    memset(&matrix_data_a, 0, sizeof(matrix_data_a));

    MATRIX mat_a;
    MATRIX mat_b;
    MATRIX mat_c;

    // assign memory regions
    {
        mat_a.pData = matrix_data_a; //malloc(EST_MAX_PARAMS * EST_MAX_PARAMS * sizeof(float16_t));
        mat_b.pData = matrix_data_b; //malloc(EST_MAX_PARAMS * EST_MAX_PARAMS * sizeof(float16_t));
        mat_c.pData = matrix_data_c; //malloc(EST_MAX_PARAMS * EST_MAX_PARAMS * sizeof(float16_t));

        // TODO: This cannot happen as we statically defined them.
//        if (mat_a.pData == NULL || mat_b.pData == NULL || mat_c.pData == NULL ) {
//             LOG_INF("Allocation failed...");
//            return false;
//        }
    }

    // Store X in mat_a
    {
        // TODO: we do not these this many rows usually!
        mat_a.numRows = num_input_rows;
        mat_a.numCols = num_input_cols;

        // as the parameter indices

        int param_index = 0;

        // first add all the delays
        for(int a = 0; a < num_nodes; a++) {
            if (delay_known[a]) {
                continue; // this one is not relevant here
            }

            // we have to loop through all nodes to get also the reverse combination
            for(size_t b = 0; b < num_nodes; b++) {
                if (a == b) {
                    continue;
                }
                size_t pi = pair_index(a, b);
                if (max_pair_variance > 0.0 && var_measurements != NULL && var_measurements[pi] >= max_pair_variance) {
                    continue; // we skip this entry as it has too high variance, note that we do not change parameter indices because of it
                }
                matrix_data_a[(pi * num_input_cols) + param_index] = 1.0;
            }
            param_index++;
        }

         for(int a = 0; a < num_nodes; a++) {
            for(int b = 0; b < a; b++) {
                size_t pi = pair_index(a, b);

                 if (tof_known[pi]) {
                     continue; // this one is not relevant here
                 }

                 matrix_data_a[(pi * num_input_cols) + param_index] = 2.0; // the distance is of factor two
                 param_index++;
            }
         }

         if (param_index != num_input_cols) {
            LOG_ERR("aram_index != num_input_cols, %d, %d", param_index, num_input_cols);
            return;
         }

        //LOG_DBG("Matrix X:");
        //print_matrix(&mat_a);
    }

    // transpose X to mat_b
    {
        mat_b.numRows = num_input_cols;
        mat_b.numCols = num_input_rows;

        ret = OP_TRANS(&mat_a, &mat_b);
         if (ret == ARM_MATH_SIZE_MISMATCH ) {
             LOG_INF("SIZE MISMATCH... A");
            return false;
        }
    }


    // multiply X^T (mat_b) with X (mat_a) and store in mat_c
    {
        mat_c.numRows = num_input_cols;
        mat_c.numCols = num_input_cols;

        ret = OP_MULT(&mat_b, &mat_a, &mat_c);

        if (ret == ARM_MATH_SIZE_MISMATCH ) {
             LOG_INF("SIZE MISMATCH... B");
            return false;
        }
    }

    // invert (X^T X) (mat_c) and store in mat_a
    // we keep mat_b as we need the transpose in the next step
    {
        mat_a.numRows = num_input_cols;
        mat_a.numCols = num_input_cols;

        ret = OP_INV(&mat_c, &mat_a);

        if (ret == ARM_MATH_SIZE_MISMATCH ) {
             LOG_INF("SIZE MISMATCH... C");
            return false;
        }
    }

    // multiply (X^T X)^{-1} (mat_a) with X^T (mat_b) and store in mat_c
    {
        mat_c.numRows = num_input_cols;
        mat_c.numCols = num_input_rows;

        ret = OP_MULT(&mat_a, &mat_b, &mat_c);

        if (ret == ARM_MATH_SIZE_MISMATCH ) {
             LOG_INF("SIZE MISMATCH... D");
            return false;
        }
    }


    // load Y into mat_b
    {
        mat_b.numRows = num_input_rows;
        mat_b.numCols = 1;
        //TODO: implement this

        // we first store all of the measurements
        for(size_t a = 0; a < num_nodes; a++) {
            for(size_t b = 0; b < a; b++) {
                size_t pi = pair_index(a, b);
                float32_t val;
                if (delay_known[a] && delay_known[b] && tof_known[pi]) {
                    val = 0.0; // nothing todo here! this is a null row...
                }
                else if (delay_known[a] && max_pair_variance > 0.0 && var_measurements != NULL && var_measurements[pi] >= max_pair_variance) {
                    val = 0.0; // we remove this entire row BUT just for antenna delay estimation!
                }
                else {
                    val = mean_measurements[pi] * 2.0;  // we need to scale this accordingly

                    if (delay_known[a]) {
                        val -= known_delays[a];
                    }
                    if (delay_known[b]) {
                        val -= known_delays[b];
                    }
                    if(tof_known[pi]) {
                        val -= known_tofs[pi]*2.0; //tof has factor two!
                    }

                }
                matrix_data_b[pi] = val;
            }
        }

//        LOG_DBG("Matrix Y:");
//        print_matrix(&mat_b);
    }

    // multiply (X^T X)^{-1}  X^T (mat_c) with Y (mat_b) and store in mat_a
    {
        mat_a.numRows = num_input_cols;
        mat_a.numCols = 1;

        ret = OP_MULT(&mat_c, &mat_b, &mat_a);

        if (ret == ARM_MATH_SIZE_MISMATCH ) {
             LOG_INF("SIZE MISMATCH... E");
            return;
        }
    }


//    LOG_DBG("Estimate:");
//    print_matrix(&mat_a);

    {
        // copy stuff to out buffers
        int param_index = 0;

        // first copy all the delays
        for(int a = 0; a < num_nodes; a++) {
            if (delay_known[a]) {
                if (delays_out != NULL){
                    delays_out[a] = known_delays[a];
                }
            } else {
                if (delays_out != NULL){
                    delays_out[a] = matrix_data_a[param_index];
                }
                param_index++;
            }
        }


        // TODO: we cannot infer tofs because of memory constraints...
        // so we simply calculate them manually here...

        for(int a = 0; a < num_nodes; a++) {
            for(int b = 0; b < a; b++) {
                size_t pi = pair_index(a, b);

                 if (tof_known[pi]) {
                    if (tofs_out != NULL) {
                        tofs_out[pi] = known_tofs[pi];
                    }
                 } else {
                    if (tofs_out != NULL) {
                    // TODO: This might not work as planned?
                        tofs_out[pi] = mean_measurements[pi] - 0.5*delays_out[a] - 0.5*delays_out[b];
                    }
                    param_index++; // we only have that here so it
                 }
            }
         }


//         for(int a = 0; a < num_nodes; a++) {
//            for(int b = 0; b < a; b++) {
//
//                size_t pi = pair_index(a, b);
//
//                 if (tof_known[pi]) {
//                    if (tofs_out != NULL) {
//                        tofs_out[pi] = known_tofs[pi];
//                    }
//                 } else {
//                    if (tofs_out != NULL) {
//                        tofs_out[pi] = matrix_data_a[param_index];
//                    }
//                    param_index++;
//                 }
//            }
//         }

         if (param_index != num_input_cols) {
            LOG_ERR("aram_index != num_input_cols, %d, %d", param_index, num_input_cols);
            return;
         }
     }
}


static inline void output_measurement(measurement_t val) {
        char buf[32];
        int64_t int_val = val * 1000.0f;
        snprintf(buf, sizeof(buf), "%lld", int_val);
        uart_out(buf);
}

static void output_measurements(measurement_t *out, size_t num, bool *known) {

    uart_out("[");
    for(size_t i = 0; i < num; i ++) {
        if (known == NULL || known[i]) {
            output_measurement(out[i]);
        } else {
            uart_out("null");
        }

        if (i < num-1) {
            uart_out(", ");
        }
    }
    uart_out("]");
}


static void log_estimation(
    uint8_t num_nodes,
    float32_t delays_out[EST_MAX_NODES],
    float32_t tofs_out[EST_MAX_PAIRS],
    float32_t mean_measurements[EST_MAX_PAIRS],
    float32_t var_measurements[EST_MAX_PAIRS],
    bool delay_known[EST_MAX_NODES],
    float32_t known_delays[EST_MAX_NODES],
    bool tof_known[EST_MAX_PAIRS],
    float32_t known_tofs[EST_MAX_PAIRS]
) {
     uart_out("{ \"mean_measurements\": ");
     output_measurements(mean_measurements, EST_MAX_PAIRS, NULL);
     uart_out("{ \"var_measurements\": ");
     output_measurements(var_measurements, EST_MAX_PAIRS, NULL);

     // we further log the standard deviations
     float32_t std_measurements[EST_MAX_PAIRS];

     for(int i = 0; i < EST_MAX_PAIRS; i++) {
           std_measurements[i] = sqrt(var_measurements[i]);
     }

     uart_out("{ \"std_measurements\": ");
     output_measurements(std_measurements, EST_MAX_PAIRS, NULL);

     uart_out(", \"delays_out\": ");
     output_measurements(delays_out, EST_MAX_NODES, NULL);
     uart_out(", \"tofs_out\": ");
     output_measurements(tofs_out, EST_MAX_PAIRS, NULL);
     uart_out(", \"known_delays\": ");
     output_measurements(known_delays, EST_MAX_NODES, NULL); // we just assume we know everything for now
     uart_out(", \"known_tofs\": ");
     output_measurements(known_tofs, EST_MAX_PAIRS, NULL); // we just assume we know everything for now
        uart_out("}");
}

static void infer_tofs_out(
    uint8_t num_nodes,
    float32_t delays_out[EST_MAX_NODES],
    float32_t tofs_out[EST_MAX_PAIRS],
    float32_t mean_measurements[EST_MAX_PAIRS]
) {
     for(int a = 0; a < num_nodes; a++) {
        for(int b = 0; b < a; b++) {
            size_t pi = pair_index(a, b);
            tofs_out[pi] = mean_measurements[pi] - 0.5*delays_out[a] - 0.5*delays_out[b];
        }
     }
}

void estimate_all(uint16_t round) {

    static measurement_t delays_out[EST_MAX_NODES] = {0.0};
    static measurement_t tofs_out[EST_MAX_PAIRS] = {0.0};
    static measurement_t mean_measurements[EST_MAX_PAIRS] = {0.0};
    static measurement_t var_measurements[EST_MAX_PAIRS] = {0.0};

    static bool delay_known[EST_MAX_NODES];
    static measurement_t known_delays[EST_MAX_NODES];
    static bool tof_known[EST_MAX_PAIRS];
    static measurement_t known_tofs[EST_MAX_PAIRS];

    int64_t estimate_start = 0;
    int64_t estimate_duration = 0;

    //for(int n = EST_MAX_NODES; n <= EST_MAX_NODES; n++)
    int n = EST_MAX_NODES; // we just execute it for a single node right now
    {
        uart_out("{\"type\": \"estimation\", ");
         char buf[32];
         snprintf(buf, sizeof(buf), "\"round\": %hu", round);
         uart_out(buf);

        //initialize known values (measurements, delays, distances
        for(int i = 0; i < n; i++) {
            known_delays[i] = (float32_t) node_factory_antenna_delay_offsets[i];
        }

        for(int p = 0; p < PAIRS(n); p++) {
            known_tofs[p] = node_distances[p] / SPEED_OF_LIGHT_M_PER_UWB_TU;
            // TODO: If we reorder, we have to be careful with those distances!
            mean_measurements[p] = get_mean_measurement(p);
            var_measurements[p] = get_var_measurement(p);
        }

        uart_out(", \"mean_measurements\": ");
        output_measurements(mean_measurements, PAIRS(n), NULL);

        uart_out(", \"var_measurements\": ");
        output_measurements(var_measurements, PAIRS(n), NULL);

        // first estimate antenna delays based on all known distances WITHOUT filtering
        {
            memset(tof_known, 1, sizeof(tof_known));
            memset(delay_known, 0, sizeof(delay_known));

            estimate_start = k_uptime_get();
            estimate(
                n,
                delays_out,
                tofs_out,
                mean_measurements,
                var_measurements,
                delay_known,
                known_delays,
                tof_known,
                known_tofs,
                0.0
            );
            estimate_duration = k_uptime_delta(&estimate_start);

            uart_out(", \"delays_from_measurements\": ");
            output_measurements(delays_out, n, NULL);

            uart_out(", \"delays_from_measurements_time\": ");
            snprintf(buf, sizeof(buf), "%lld", estimate_duration);
            uart_out(buf);
        }

        // now use the new delays to infer the distances again -> should result in the same distances basically...
        {
            // we now use the new delay values
            for(int i = 0; i < n; i++) {
                known_delays[i] = delays_out[i];
            }
             for(int p = 0; p < PAIRS(n); p++) {
                // TODO: If we reorder, we have to be careful with those distances!
                mean_measurements[p] = get_mean_measurement(p);
                known_tofs[p] = node_distances[p] / SPEED_OF_LIGHT_M_PER_UWB_TU;
            }

            memset(tof_known, 0, sizeof(tof_known));
            memset(delay_known, 1, sizeof(delay_known));

            estimate_start = k_uptime_get();

            infer_tofs_out(
                n,
                delays_out,
                tofs_out,
                mean_measurements
            );

            estimate_duration = k_uptime_delta(&estimate_start);

            uart_out(", \"tofs_from_estimated_delays\": ");
            output_measurements(tofs_out, PAIRS(n), NULL);

            uart_out(", \"tofs_from_estimated_delays_time\": ");
            snprintf(buf, sizeof(buf), "%lld", estimate_duration);
            uart_out(buf);
        }

        // estimate antenna delays on all known distances WITH filtering
        {
            // reset values just to be sure
            memset(delays_out, 0, sizeof(delays_out));
            memset(tofs_out, 0, sizeof(tofs_out));

            memset(tof_known, 1, sizeof(tof_known));
            memset(delay_known, 0, sizeof(delay_known));

            estimate_start = k_uptime_get();
            estimate(
                n,
                delays_out,
                tofs_out,
                mean_measurements,
                var_measurements,
                delay_known,
                known_delays,
                tof_known,
                known_tofs,
                MAX_VAR_IN_M
            );
            estimate_duration = k_uptime_delta(&estimate_start);

            uart_out(", \"delays_from_measurements_filtered\": ");
            output_measurements(delays_out, n, NULL);

            uart_out(", \"delays_from_measurements_filtered_time\": ");
            snprintf(buf, sizeof(buf), "%lld", estimate_duration);
            uart_out(buf);
        }

        // now use the Filtered delays to infer the distances again -> should result in the same distances basically...
        {
            // we now use the new delay values
            for(int i = 0; i < n; i++) {
                known_delays[i] = delays_out[i];
            }
             for(int p = 0; p < PAIRS(n); p++) {
                // TODO: If we reorder, we have to be careful with those distances!
                mean_measurements[p] = get_mean_measurement(p);
                known_tofs[p] = node_distances[p] / SPEED_OF_LIGHT_M_PER_UWB_TU;
            }

            memset(tof_known, 0, sizeof(tof_known));
            memset(delay_known, 1, sizeof(delay_known));

            estimate_start = k_uptime_get();
             infer_tofs_out(
                n,
                delays_out,
                tofs_out,
                mean_measurements
            );
            estimate_duration = k_uptime_delta(&estimate_start);

            uart_out(", \"tofs_from_filtered_estimated_delays\": ");
            output_measurements(tofs_out, PAIRS(n), NULL);

            uart_out(", \"tofs_from_filtered_estimated_delays_time\": ");
            snprintf(buf, sizeof(buf), "%lld", estimate_duration);
            uart_out(buf);
        }


        // now use FACTORY delays to infer the distances again -> should result in the same distances basically...
        {
            // we now use the new delay values
            for(int i = 0; i < n; i++) {
                delays_out[i] = (float32_t) node_factory_antenna_delay_offsets[i];
            }
             for(int p = 0; p < PAIRS(n); p++) {
                // TODO: If we reorder, we have to be careful with those distances!
                mean_measurements[p] = get_mean_measurement(p);
                known_tofs[p] = node_distances[p] / SPEED_OF_LIGHT_M_PER_UWB_TU;
            }

            memset(tof_known, 0, sizeof(tof_known));
            memset(delay_known, 1, sizeof(delay_known));

            estimate_start = k_uptime_get();
            infer_tofs_out(
                n,
                delays_out,
                tofs_out,
                mean_measurements
            );
            estimate_duration = k_uptime_delta(&estimate_start);

            uart_out(", \"tofs_from_factory_delays\": ");
            output_measurements(tofs_out, PAIRS(n), NULL);

            uart_out(", \"tofs_from_factory_delays_time\": ");
            snprintf(buf, sizeof(buf), "%lld", estimate_duration);
            uart_out(buf);

        }

        // now use the new delays to infer the distances again -> should result in the same distances basically...
        {
            // we now use the new delay values
            for(int i = 0; i < n; i++) {
                delays_out[i] = 0; // no differences in the delays here
            }
             for(int p = 0; p < PAIRS(n); p++) {
                // TODO: If we reorder, we have to be careful with those distances!
                mean_measurements[p] = get_mean_measurement(p);
                known_tofs[p] = node_distances[p] / SPEED_OF_LIGHT_M_PER_UWB_TU;
            }

            memset(tof_known, 0, sizeof(tof_known));
            memset(delay_known, 1, sizeof(delay_known));

            estimate_start = k_uptime_get();
            infer_tofs_out(
                n,
                delays_out,
                tofs_out,
                mean_measurements
            );
            estimate_duration = k_uptime_delta(&estimate_start);

            uart_out(", \"tofs_uncalibrated\": ");
            output_measurements(tofs_out, PAIRS(n), NULL);

            uart_out(", \"tofs_uncalibrated_time\": ");
            snprintf(buf, sizeof(buf), "%lld", estimate_duration);
            uart_out(buf);
        }
        uart_out("}\n");
    }
}
```

## src/estimation.h
```c
#ifndef ESTIMATION_H
#define ESTIMATION_H

#include <arm_math_f16.h>
#include <logging/log.h>
#include <stdio.h>

#define EST_MAX_NODES (NUM_NODES)
#define EST_MAX_PAIRS (PAIRS(EST_MAX_NODES))
#define EST_MAX_PARAMS (EST_MAX_NODES)
#define EST_MAX_INPUTS (EST_MAX_PAIRS)

//#define SPEED_OF_LIGHT_M_PER_S 299792458.0
#define SPEED_OF_LIGHT_M_PER_S 299702547.236
#define SPEED_OF_LIGHT_M_PER_UWB_TU ((SPEED_OF_LIGHT_M_PER_S * 1.0E-15) * 15650.0) // around 0.00469175196

void estimate_all(uint16_t round);

#endif
```

## src/history.c
```c
#include <logging/log.h>
#include <zephyr.h>

#include <net/net_core.h>
#include <net/ieee802154_radio.h>
#include <drivers/ieee802154/dw1000.h>
#include <stdio.h>

#include "history.h"
#include "log.h"

#define HISTORY_LENGTH 1420

K_SEM_DEFINE(hist_buf_sem, 1, 1);

struct __attribute__((__packed__)) history_record {
    uint8_t txrx_number; // of rx_number == own_number it was a tx!
    uint8_t own_number;
    int8_t rssi;
    int8_t bias_correction;
    uint16_t txrx_round;
    uint16_t txrx_slot;
    uint64_t txrx_ts;
    uint64_t bias_corrected_rx_ts;
    int32_t carrierintegrator;
    //uint8_t rx_ttcko_rc_phase;
};

static int num_stored = 0;

static struct history_record history[HISTORY_LENGTH] = {0};

void history_reset() {
    k_sem_take(&hist_buf_sem, K_FOREVER);
    memset(&history, 0, sizeof(history));
    num_stored = 0;
    k_sem_give(&hist_buf_sem);
}

size_t history_count() {
    return num_stored;
}

int history_save_rx(uint8_t own_number, uint8_t rx_number, uint16_t rx_round, uint16_t rx_slot, uint64_t rx_ts, int32_t carrierintegrator, int8_t rssi, int8_t bias_correction, uint64_t bias_corrected_rx_ts, uint8_t rx_ttcko_rc_phase) {
    k_sem_take(&hist_buf_sem, K_FOREVER);

    if (num_stored == HISTORY_LENGTH){
        k_sem_give(&hist_buf_sem);
        return -1;
    }

    struct history_record *h = &history[num_stored];

    h->txrx_number = rx_number; // of rx_number == own_number it was a tx!
    h->own_number = own_number;
    h->rssi = rssi;
    h->bias_correction = bias_correction;
    h->txrx_round = rx_round;
    h->txrx_slot = rx_slot;
    h->txrx_ts = rx_ts;
    h->bias_corrected_rx_ts = bias_corrected_rx_ts;
    h->carrierintegrator = carrierintegrator;
    //h->rx_ttcko_rc_phase = rx_ttcko_rc_phase;

    num_stored++;

    k_sem_give(&hist_buf_sem);
    return 0;
}

int history_save_tx(uint8_t own_number, uint16_t tx_round, uint16_t tx_slot, uint64_t tx_ts) {
    k_sem_take(&hist_buf_sem, K_FOREVER);

    if (num_stored == HISTORY_LENGTH){
        k_sem_give(&hist_buf_sem);
        return -1;
    }

    struct history_record *h = &history[num_stored];

    h->txrx_number = own_number; // of rx_number == own_number it was a tx!
    h->own_number = own_number;
    h->txrx_round = tx_round;
    h->txrx_slot = tx_slot;
    h->txrx_ts = tx_ts;
    h->rssi = 0;
    h->bias_correction = 0;
    h->bias_corrected_rx_ts = 0;
    h->carrierintegrator = 0;
    //h->rx_ttcko_rc_phase = 0;

    num_stored++;

    k_sem_give(&hist_buf_sem);
    return 0;
}


void history_print() {

    k_sem_take(&hist_buf_sem, K_FOREVER);

    char buf[768];
    for (size_t i = 0; i < num_stored; i++) {

        struct history_record *h = &history[i];

        if (h->own_number != h->txrx_number) {
            //snprintf(buf, sizeof(buf), "{\"event\": \"rx\", \"own_number\": %hhu, \"rx_number\": %hhu, \"rx_round\": %hu, \"rx_slot\": %hu, \"rx_ts\": %llu, \"ci\": %d, \"rssi\": %hhd, \"bias_correction\": %hhd, \"bias_corrected_rx_ts\": %llu, \"rx_ttcko_rc_phase\": %hhu}\n", h->own_number, h->txrx_number, h->txrx_round, h->txrx_slot, h->txrx_ts, h->carrierintegrator, h->rssi, h->bias_correction, h->bias_corrected_rx_ts, h->rx_ttcko_rc_phase);
            snprintf(buf, sizeof(buf), "{\"event\": \"rx\", \"own_number\": %hhu, \"rx_number\": %hhu, \"rx_round\": %hu, \"rx_slot\": %hu, \"rx_ts\": %llu, \"ci\": %d, \"rssi\": %hhd, \"bias_correction\": %hhd, \"bias_corrected_rx_ts\": %llu}\n", h->own_number, h->txrx_number, h->txrx_round, h->txrx_slot, h->txrx_ts, h->carrierintegrator, h->rssi, h->bias_correction, h->bias_corrected_rx_ts);
        } else {
            // this is a transmission.
            snprintf(buf, sizeof(buf), "{\"event\": \"tx\", \"own_number\": %hhu, \"tx_round\": %hu, \"tx_slot\": %hu, \"tx_ts\": %llu}\n", h->own_number, h->txrx_round, h->txrx_slot, h->txrx_ts);
        }
        uart_out(buf);
    }
    k_sem_give(&hist_buf_sem);
}
```

## src/history.h
```c
#ifndef HISTORY_H
#define HISTORY_H

#include "nodes.h"

typedef uint8_t ts_t[5];

void history_reset();
size_t history_count();
int history_save_rx(uint8_t own_number, uint8_t rx_number, uint16_t rx_round, uint16_t rx_slot, uint64_t rx_ts, int32_t carrierintegrator, int8_t rssi, int8_t bias_correction, uint64_t bias_corrected_rx_ts, uint8_t rx_ttcko_rc_phase);
int history_save_tx(uint8_t own_number, uint16_t tx_round, uint16_t tx_slot, uint64_t tx_ts);
void history_print();

#endif
```

## src/log.c
```c
#include <drivers/uart.h>
#include <zephyr.h>
#include <logging/log.h>
#include "log.h"
#include "nodes.h"

#define LOG_BUF_SIZE (8192)

LOG_MODULE_REGISTER(logging);


static const struct device* uart_device = DEVICE_DT_GET(DT_CHOSEN(zephyr_console));

K_SEM_DEFINE(log_buf_sem, 1, 1);

void uart_out(char* msg) {
    k_sem_take(&log_buf_sem, K_FOREVER);
    while (*msg != '\0') {
        uart_poll_out(uart_device, *msg);
        msg++;
    }
    k_sem_give(&log_buf_sem);
}

void uart_disabled(char* msg) {
    //NOOP
}



static char log_buf[LOG_BUF_SIZE] = {0};
static size_t log_buf_count = 0;


void log_out(char* msg) {
    k_sem_take(&log_buf_sem, K_FOREVER);

    while (*msg != '\0' && log_buf_count < LOG_BUF_SIZE) {
        log_buf[log_buf_count] = *msg;
        log_buf_count++;
        msg++;
    }

    k_sem_give(&log_buf_sem);

    if (log_buf_count == LOG_BUF_SIZE-1) {
        LOG_WRN("LOG IS FULL!!!");
    }
}

void log_flush() {
    k_sem_take(&log_buf_sem, K_FOREVER);

    for (size_t i = 0; i < log_buf_count; i++) {
        uart_poll_out(uart_device, log_buf[i]);
    }

    log_buf_count = 0;
    (void)memset(&log_buf, 0, sizeof(log_buf));

    k_sem_give(&log_buf_sem);
}


size_t log_get_count() {
    return log_buf_count;
}
```

## src/log.h
```c
#ifndef LOG_H
#define LOG_H


void uart_out(char* msg);
void uart_disabled(char* msg);

void log_out(char* msg);
void log_flush();

#endif
```

## src/matrix_test.c
```c
#include <zephyr.h>
#include <stdlib.h>
#include <arm_math_f16.h>
#include <logging/log.h>

#define NUM_NODES 12
#define NUM_PARAMS ((NUM_NODES*(NUM_NODES+1))/2)


LOG_MODULE_REGISTER(matrix_test);

static float16_t matrix_data_a[NUM_PARAMS * NUM_PARAMS];
static float16_t matrix_data_b[NUM_PARAMS * NUM_PARAMS];
static float16_t matrix_data_c[NUM_PARAMS * NUM_PARAMS];


bool matrix_test_f16() {
    LOG_INF("matrix_test_f16");

    int ret = 0;
    arm_matrix_instance_f16 mat_a;
    arm_matrix_instance_f16 mat_b;
    arm_matrix_instance_f16 mat_c;

    // assign memory regions
    {
        mat_a.pData = matrix_data_a; //malloc(NUM_PARAMS * NUM_PARAMS * sizeof(float16_t));
        mat_b.pData = matrix_data_b; //malloc(NUM_PARAMS * NUM_PARAMS * sizeof(float16_t));
        mat_c.pData = matrix_data_c; //malloc(NUM_PARAMS * NUM_PARAMS * sizeof(float16_t));


        if (mat_a.pData == NULL || mat_b.pData == NULL || mat_c.pData == NULL ) {
             LOG_INF("Allocation failed...");
            return false;
        }
    }


    // Store X in mat_a
    {
        // TODO: actually store it!
        mat_a.numRows = NUM_PARAMS;
        mat_a.numCols = NUM_PARAMS;
    }

    // transpose X to mat_b
    {
        mat_b.numRows = NUM_PARAMS;
        mat_b.numCols = NUM_PARAMS;

        ret = arm_mat_trans_f16(&mat_a, &mat_b);
         if (ret == ARM_MATH_SIZE_MISMATCH ) {
             LOG_INF("SIZE MISMATCH... A");
            return false;
        }
    }

    // multiply X^T (mat_b) with X (mat_a) and store in mat_c
    {
        mat_c.numRows = NUM_PARAMS;
        mat_c.numCols = NUM_PARAMS;

        ret = arm_mat_mult_f16(&mat_b, &mat_a, &mat_c);

        if (ret == ARM_MATH_SIZE_MISMATCH ) {
             LOG_INF("SIZE MISMATCH... B");
            return false;
        }
    }


    // invert (X^T X) (mat_c) and store in mat_a
    // we keep mat_b as we need the transpose in the next step
    {
        mat_a.numRows = NUM_PARAMS;
        mat_a.numCols = NUM_PARAMS;

        ret = arm_mat_inverse_f16(&mat_c, &mat_a);

        if (ret == ARM_MATH_SIZE_MISMATCH ) {
             LOG_INF("SIZE MISMATCH... C");
            return false;
        }
    }

    // multiply (X^T X)^{-1} (mat_a) with X^T (mat_b) and store in mat_c
    {
        mat_c.numRows = NUM_PARAMS;
        mat_c.numCols = NUM_PARAMS;

        ret = arm_mat_mult_f16(&mat_a, &mat_b, &mat_c);

        if (ret == ARM_MATH_SIZE_MISMATCH ) {
             LOG_INF("SIZE MISMATCH... D");
            return false;
        }
    }


    // load Y into mat_b
    {
        //TODO: implement this
        mat_b.numRows = NUM_PARAMS;
        mat_b.numCols = 1;
    }

    // multiply (X^T X)^{-1}  X^T (mat_c) with Y (mat_b) and store in mat_a
    {
        mat_a.numRows = NUM_PARAMS;
        mat_a.numCols = 1;

        ret = arm_mat_mult_f16(&mat_c, &mat_b, &mat_a);

        if (ret == ARM_MATH_SIZE_MISMATCH ) {
             LOG_INF("SIZE MISMATCH... E");
            return false;
        }
    }
     LOG_INF("Done!!");

    return true;
}

void matrix_test() {
    matrix_test_f16();

}
```

## src/measurements.c
```c
#include <zephyr.h>
#include <stdlib.h>
#include <arm_math_f16.h>
#include <stdio.h>
#include <logging/log.h>

#include "measurements.h"
#include "nodes.h"


LOG_MODULE_REGISTER(measurements);

#if 1

static struct {
    size_t count;
    float32_t mean;
    float32_t M2;
} aggr[NUM_PAIRS];

// For a new value newValue, compute the new count, new mean, the new M2.
// mean accumulates the mean of the entire dataset
// M2 aggregates the squared distance from the mean
// count aggregates the number of samples seen so far
void aggr_add(int index, float32_t newValue) {
    aggr[index].count += 1;
    float32_t delta = newValue - aggr[index].mean;
    aggr[index].mean += delta / (float32_t) aggr[index].count;
    float32_t delta2 = newValue - aggr[index].mean;
    aggr[index].M2 += delta * delta2;
}

void aggr_reset(int index) {
    aggr[index].count = 0;
    aggr[index].mean = 0.0;
    aggr[index].M2 = 0.0;
}

float32_t aggr_mean(int index) {
    return aggr[index].mean;
}

float32_t aggr_variance(int index) {
    return aggr[index].M2  / (float32_t) (aggr[index].count);
}

void estimation_add_measurement(uint8_t a, uint8_t b, measurement_t val) {
    if (a == b) {
        LOG_WRN("Tried to add a measurement to itself!");
        return;
    } else if (val == 0.0) {
        LOG_WRN("Tried to add a zero measurement!");
        return;
    }

    size_t pi = pair_index(a, b);
    aggr_add(pi, val);
}

measurement_t get_mean_measurement(size_t pi) {
    return aggr_mean(pi);
}

measurement_t get_var_measurement(size_t pi) {
    return aggr_variance(pi);
}

#else

// note that we collect measurements of all nodes for now
static float32_t measurements_sum[NUM_PAIRS] = {0.0};
static float32_t measurements_sum_of_squares[NUM_PAIRS] = {0.0};

static size_t num_measurements[NUM_PAIRS] = {0}; // note that this might overflow and wrap around if >= MAX_NUM_MEASUREMENTS

void estimation_add_measurement(uint8_t a, uint8_t b, measurement_t val) {
    if (a == b) {
        //LOG_WRN("Tried to add a measurement to itself!");
        return;
    } else if (val == 0.0) {
        //LOG_WRN("Tried to add a zero measurement!");
        return;
    }

    size_t pi = pair_index(a, b);

    measurements_sum[pi] += val;    // we save it in a circular buffer
    measurements_sum_of_squares[pi] += val*val;    // we save it in a circular buffer
    num_measurements[pi]++; // we also save the amount of measurements
}

measurement_t get_mean_measurement(size_t pi) {
    if (num_measurements[pi] == 0) {
        return 0.0;
    } else {
        return measurements_sum[pi] / ((float32_t)num_measurements[pi]);
    }
}

#endif
```

## src/measurements.h
```c
#ifndef MEASUREMENTS_H
#define MEASUREMENTS_H

#include <arm_math_f16.h>
#include <logging/log.h>
#include <stdio.h>


typedef float32_t measurement_t;

void estimation_add_measurement(uint8_t a, uint8_t b, measurement_t val);
measurement_t get_mean_measurement(size_t pi);
measurement_t get_var_measurement(size_t pi);

#endif
```

## src/node_numbers.c
```c
#include <zephyr.h>
#include <drivers/hwinfo.h>
#include "node_numbers.h"


uint16_t get_own_node_id() {
    uint8_t id_buf[2] = {0};
    ssize_t copied_bytes = hwinfo_get_device_id(id_buf, sizeof(id_buf));
    return id_buf[0] << 8 | id_buf[1];
}


int8_t get_node_number(uint16_t node_id) {

    uint16_t node_ids[14] = {
        0x6b93, // c1 05 0a d2 ca 32
        0xf1c3, // 2c 8e 38 0e 2c 2f
        0xc240, // a6 e9 82 fe b9 f2
        0x013f, // b2 04 f6 33 7c 79
        0xb227, // e1 bc c5 19 92 66
        0x033b, // 5e 2a 24 f7 5d 92
        0xf524, // d8 8d 45 48 12 b9
        0x37b2, // 12 6a 1d 03 69 47
        0x15ef, // 2e fb cb ec 8d af
        0x7e02, // c2 7f f2 eb 6d e0
        0xad36, // fa 0e a0 b9 19 b7
        0x3598, // 3c 33 73 36 cb 47
        0x47e0, // c9 65 a0 9b 5b 9f
        0x0e92  // 06 79 a6 59 fe 98
    };

    for (int i = 0; i < NUM_NODES && i < sizeof(node_ids)/sizeof(node_ids[0]); i++) {
        if (node_id == node_ids[i]) {
            return i;
        }
    }

    return -1;  //node number not found!
}
```

## src/node_numbers.h
```c
#ifndef NODE_NUMBERS_H
#define NODE_NUMBERS_H

#define NUM_NODES 8
#define MAX_NUM_NODES 14

uint16_t get_own_node_id();
int8_t get_node_number(uint16_t node_id);


#endif
```

## src/nodes.c
```c
#include <zephyr.h>
#include <drivers/hwinfo.h>
#include "nodes.h"




// testbed defined in testbed.c

inline size_t pair_index(uint16_t a, uint16_t b) {
       return PAIR_INDEX(a,b);
}


uint16_t get_own_node_id() {
    uint8_t id_buf[2] = {0};
    ssize_t copied_bytes = hwinfo_get_device_id(id_buf, sizeof(id_buf));
    return id_buf[0] << 8 | id_buf[1];
}


int8_t get_node_number(uint16_t node_id) {
    for (int i = 0; i < NUM_NODES; i++) {
        if (node_id == node_ids[i]) {
            return i;
        }
    }

    return -1;  //node number not found!
}

#define RANGE_CORR_MAX_RSSI (-61)
#define RANGE_CORR_MIN_RSSI (-93)

int8_t range_bias_by_rssi[RANGE_CORR_MAX_RSSI-RANGE_CORR_MIN_RSSI+1] = {
    -23, // -61dBm (-11 cm)
    -23, // -62dBm (-10.75 cm)
    -22, // -63dBm (-10.5 cm)
    -22, // -64dBm (-10.25 cm)
    -21, // -65dBm (-10.0 cm)
    -21, // -66dBm (-9.65 cm)
    -20, // -67dBm (-9.3 cm)
    -19, // -68dBm (-8.75 cm)
    -17, // -69dBm (-8.2 cm)
    -16, // -70dBm (-7.55 cm)
    -15, // -71dBm (-6.9 cm)
    -13, // -72dBm (-6.0 cm)
    -11, // -73dBm (-5.1 cm)
    -8, // -74dBm (-3.9 cm)
    -6, // -75dBm (-2.7 cm)
    -3, // -76dBm (-1.35 cm)
    0, // -77dBm (0.0 cm)
    2, // -78dBm (1.05 cm)
    4, // -79dBm (2.1 cm)
    6, // -80dBm (2.8 cm)
    7, // -81dBm (3.5 cm)
    8, // -82dBm (3.85 cm)
    9, // -83dBm (4.2 cm)
    10, // -84dBm (4.55 cm)
    10, // -85dBm (4.9 cm)
    12, // -86dBm (5.55 cm)
    13, // -87dBm (6.2 cm)
    14, // -88dBm (6.65 cm)
    15, // -89dBm (7.1 cm)
    16, // -90dBm (7.35 cm)
    16, // -91dBm (7.6 cm)
    17, // -92dBm (7.85 cm)
    17, // -93dBm (8.1 cm)
};

int8_t get_range_bias_by_rssi(int8_t rssi) {
    rssi = MAX(MIN(RANGE_CORR_MAX_RSSI, rssi), RANGE_CORR_MIN_RSSI);
    return range_bias_by_rssi[-(rssi-RANGE_CORR_MAX_RSSI)];
}
```
